## board/keithkoep/common/Kconfig
```kconfig
if !ARCH_IMX8M && !ARCH_IMX8

config CHAIN_OF_TRUST
	depends on !FIT_SIGNATURE && SECURE_BOOT
	imply CMD_BLOB
	imply CMD_HASH if ARM
	select FSL_CAAM
	select SPL_BOARD_INIT if (ARM && SPL)
	select SHA_HW_ACCEL
	select SHA_PROG_HW_ACCEL
	select ENV_IS_NOWHERE
	select CMD_EXT4 if ARM
	select CMD_EXT4_WRITE if ARM
	bool
	default y

config CMD_ESBC_VALIDATE
	bool "Enable the 'esbc_validate' and 'esbc_halt' commands"
	default y if CHAIN_OF_TRUST
	help
	  This option enables two commands used for secure booting:

	    esbc_validate - validate signature using RSA verification
	    esbc_halt - put the core in spin loop (Secure Boot Only)

endif

config VOL_MONITOR_LTC3882_READ
	depends on VID
	bool "Enable the LTC3882 voltage monitor read"
	default n
	help
	 This option enables LTC3882 voltage monitor read
	 functionality. It is used by common VID driver.

config VOL_MONITOR_LTC3882_SET
	depends on VID
	bool "Enable the LTC3882 voltage monitor set"
	default n
	help
	 This option enables LTC3882 voltage monitor set
	 functionality. It is used by common VID driver.

config USB_TCPC
	bool "USB Typec port controller simple driver"
	default n
	help
	  Enable USB type-c port controller (TCPC) driver



config ENGINEERINGSAMPLE_MYON2
       bool "Select REV1_MYON2, if no rev is set, OTP will select targetboard info"
       default n

config ENGINEERINGSAMPLE_TRIZEPS8MINI
       bool "Select REV1_MTRIZEPS8MINI, if no rev is set, OTP will select targetboard info"
       default n

config MYON2
       bool "Select MYON2, if no rev is set, OTP will select targetboard info"
       default n

config TRIZEPS8MINI
       bool "Select TRIZEPS8MINI, if no rev is set, OTP will select targetboard info"
       default n

config MYON2_V1R1_2GB
       bool "Select V1R1 MYON2 with 2GB RAM and override possibly set OTP fuses"
       default n

config TRIZEPS8MINI_V1R2_2GB
       bool "Select V1R2 TRIZEPS8MINI with 2GB RAM and override possibly set OTP fuses"
       default n

config MOUNTOPTION_EMMC
       bool "Select Module has EMMC instead of SD-slot."
       default n

config MOUNTOPTION_SD
       bool "Select Module has SD-slot instead of EMMC."
       default n

config BOOT_EXTSDCARD
       bool "Select to boot Image from external SD-Card"
       default n
```

## board/keithkoep/trizeps8/Kconfig
```kconfig
if TARGET_TRIZEPS8

config SYS_BOARD
	default "trizeps8"

config SYS_VENDOR
	default "keithkoep"

config SYS_CONFIG_NAME
	default "trizeps8"

source "board/keithkoep/common/Kconfig"

endif
```

## board/keithkoep/trizeps8mini/Kconfig
```kconfig
if TARGET_TRIZEPS8MINI

config SYS_BOARD
	default "trizeps8mini"

config SYS_VENDOR
	default "keithkoep"

config SYS_CONFIG_NAME
	default "trizeps8mini"

config TRIZEPS8MINI_TARGET_REV
       int "revision target-type for ddr init"
       default 1
       help
       set 1 for Trizeps4mini V1R1
       set 2 for Trizeps4mini V1R2/Myon2       

source "board/keithkoep/common/Kconfig"

endif
```

## board/keithkoep/trizeps8nano/Kconfig
```kconfig
if TARGET_TRIZEPS8NANO

config SYS_BOARD
	default "trizeps8nano"

config SYS_VENDOR
	default "keithkoep"

config SYS_CONFIG_NAME
	default "trizeps8nano"

source "board/keithkoep/common/Kconfig"

endif
```

## configs/trizeps8_android_defconfig
```kconfig
CONFIG_ARM=y
CONFIG_ARCH_IMX8M=y
CONFIG_SYS_TEXT_BASE=0x40200000
CONFIG_SYS_MALLOC_F_LEN=0x2000
# CONFIG_USB_TCPC is not set
CONFIG_TARGET_TRIZEPS8=y
CONFIG_SYS_EXTRA_OPTIONS="IMX_CONFIG=arch/arm/mach-imx/spl_sd.cfg,SPL_TEXT_BASE=0x7E1000,ANDROID_SUPPORT"
CONFIG_FIT=y
CONFIG_SPL_LOAD_FIT=y
CONFIG_ARCH_MISC_INIT=y
CONFIG_SPL=y
CONFIG_SPL_BOARD_INIT=y
CONFIG_SPL_MMC_SUPPORT=y
CONFIG_HUSH_PARSER=y
CONFIG_OF_LIBFDT=y
CONFIG_FS_FAT=y
CONFIG_CMD_EXT2=y
CONFIG_CMD_EXT4=y
CONFIG_CMD_EXT4_WRITE=y
CONFIG_CMD_FAT=y
CONFIG_DEFAULT_DEVICE_TREE="kuk-trizeps8"
CONFIG_DEFAULT_FDT_FILE="kuk-trizeps8.dtb"
CONFIG_ENV_IS_IN_MMC=y
# CONFIG_CMD_SF=y
CONFIG_CMD_I2C=y
CONFIG_CMD_GPIO=y
CONFIG_CMD_CACHE=y
CONFIG_CMD_REGULATOR=y
CONFIG_CMD_MEMTEST=y
CONFIG_OF_CONTROL=y
CONFIG_FASTBOOT=y
CONFIG_USB_FUNCTION_FASTBOOT=y
CONFIG_CMD_FASTBOOT=y
CONFIG_CMD_BOOTZ=y
CONFIG_ANDROID_BOOT_IMAGE=y
CONFIG_FSL_FASTBOOT=y
CONFIG_FASTBOOT_BUF_ADDR=0x40480000
CONFIG_FASTBOOT_BUF_SIZE=0x19000000
CONFIG_FASTBOOT_FLASH=y
CONFIG_FASTBOOT_FLASH_MMC_DEV=0

CONFIG_DM_GPIO=y
CONFIG_DM_I2C=y
CONFIG_SYS_I2C_MXC=y
CONFIG_DM_MMC=y
# CONFIG_DM_PMIC=y
CONFIG_EFI_PARTITION=y



CONFIG_DM_ETH=y
CONFIG_PINCTRL=y
CONFIG_PINCTRL_IMX8M=y
CONFIG_DM_REGULATOR=y
CONFIG_DM_REGULATOR_FIXED=y
CONFIG_DM_REGULATOR_GPIO=y

CONFIG_DM_PMIC=y
CONFIG_DM_PMIC_PFUZE100=y

CONFIG_DM_REGULATOR_PFUZE100=y



CONFIG_CMD_PMIC=y
CONFIG_NXP_TMU=y
CONFIG_DM_THERMAL=y
CONFIG_USB=y
CONFIG_DM_USB=y
CONFIG_LZ4=y
CONFIG_USB_GADGET=y
CONFIG_USB_GADGET_DOWNLOAD=y
CONFIG_SPL_USB_HOST_SUPPORT=y
CONFIG_SPL_USB_GADGET_SUPPORT=y
CONFIG_SPL_USB_SDP_SUPPORT=y
CONFIG_SDP_LOADADDR=0x40400000
CONFIG_USB_GADGET_MANUFACTURER="FSL"
CONFIG_USB_GADGET_VENDOR_NUM=0x0525
CONFIG_USB_GADGET_PRODUCT_NUM=0xa4a5

# CONFIG_FASTBOOT=y
# CONFIG_USB_FUNCTION_FASTBOOT=y
# CONFIG_CMD_FASTBOOT=y
# CONFIG_FSL_FASTBOOT=y
# CONFIG_FASTBOOT_BUF_ADDR=0x42800000
# CONFIG_FASTBOOT_BUF_SIZE=0x40000000
# CONFIG_FASTBOOT_FLASH=y
# CONFIG_FASTBOOT_FLASH_MMC_DEV=0

CONFIG_VIDEO=y
CONFIG_VIDEO_IMX8_HDMI=y


CONFIG_USB_XHCI_HCD=y
CONFIG_USB_XHCI_IMX8M=y
CONFIG_USB_XHCI_DWC3=y
CONFIG_USB_DWC3=y
CONFIG_USB_DWC3_GADGET=y
CONFIG_NET_RANDOM_ETHADDR=y


CONFIG_SAVED_DRAM_TIMING_BASE=0x40000000
# CONFIG_NOT_UUU_BUILD is not set
CONFIG_APPEND_BOOTARGS=y
#define CONFIG_SYS_BOOT_RAMDISK_HIGH=y
```
